## conf/distro/redsky-common.conf
```bitbake
require conf/distro/fsl-x11.conf

# Distro description
DISTRO_NAME = "RingFS (Yocto 2.2)"
DISTRO_VERSION = "2.2"

# Debian package architecture
PACKAGE_CLASSES = "package_deb"
DPKG_ARCH_ring-redsky = "armhf"
DPKG_ARCH_class-nativesdk = "amd64"
DPKG_ARCH_class-cross-canadian = "amd64"

# SDK configuration
# SDKMACHINE might be a better way to do this
SDK_ARCH = "x86_64"
SDKIMAGE_FEATURES += "dev-pkgs dbg-pkgs staticdev-pkgs"

# Layer maintainer contact information
MAINTAINER = "Jeff's Butt <jeffsbutt@ring.com>"
```

## conf/distro/redsky-dev.conf
```bitbake
require redsky-common.conf

# Distro description
DISTRO = "redsky-dev"
DISTRO_FEATURES = "alsa bluetooth bluez5 ext4 ppp systemd wifi"

PREFERRED_PROVIDER_virtual/kernel_mx7 = "linux-redsky-dev"

# Serial console configuration
SYSVINIT_ENABLED_GETTYS = "1"
SERIAL_CONSOLE ?= "115200 ttymxc0"
```

## conf/distro/redsky.conf
```bitbake
require redsky-common.conf

# Distro description
DISTRO = "redsky"
DISTRO_FEATURES = "alsa bluetooth bluez5 ext4 ppp systemd wifi"

PREFERRED_PROVIDER_virtual/kernel_mx7 = "linux-redsky"

# Serial console configuration
SYSVINIT_ENABLED_GETTYS = "0"
SERIAL_CONSOLES = ""
USE_VT = "0"
```

## conf/layer.conf
```bitbake
# We have a conf and classes directory, append to BBPATH
BBPATH .= ":${LAYERDIR}"

# We have a recipes directory containing .bb and .bbappend files, add to BBFILES
BBFILES += "${LAYERDIR}/recipes-*/*/*.bb \
            ${LAYERDIR}/recipes-*/*/*.bbappend"

BBFILE_COLLECTIONS += "ring"
BBFILE_PATTERN_ring := "^${LAYERDIR}/"
BBFILE_PRIORITY_ring = "9"

IMX_MIRROR ?= "http://www.freescale.com/lgfiles/NMG/MAD/YOCTO/"
QORIQ_MIRROR ?= "http://git.freescale.com/source/"

# FIXME: set this to avoid changing all the recipes that use it
FSL_MIRROR ?= "${IMX_MIRROR}"

MIRRORS += " \
${IMX_MIRROR}   http://download.ossystems.com.br/bsp/freescale/source/ \n \
${QORIQ_MIRROR} http://download.ossystems.com.br/bsp/freescale/source/ \n \
"

# The dynamic-layers directory hosts the extensions and layer specific
# modifications related to Freescale products.
#
# The .bbappend and .bb files are included if the respective layer
# collection is available.
BBFILES += "${@' '.join('${LAYERDIR}/dynamic-layers/%s/recipes*/*/*.bbappend' % layer \
               for layer in BBFILE_COLLECTIONS.split())}"
BBFILES += "${@' '.join('${LAYERDIR}/dynamic-layers/%s/recipes*/*/*.bb' % layer \
               for layer in BBFILE_COLLECTIONS.split())}"
```

## conf/machine/include/redsky-base.inc
```bitbake
#@TYPE: Machine
#@NAME: Ring Solutions i.MX7D Platform
#@SOC: i.MX7D
#@DESCRIPTION: Machine configuration for Ring Solutions i.MX7D Platform
#@MAINTAIONER: Demetrius Pampouktsis <demetrius.pampouktsis@ring.com>

include conf/machine/include/redsky-default-versions.inc
include conf/machine/include/redsky-default-providers.inc

SOC_FAMILY = "mx7:mx7d"

IMAGE_FSTYPES ?= "tar.gz ext4"

KERNEL_DEVICETREE ?= "imx7d-ring.dtb \
                      imx7d-ring-m4.dtb \
                     "

UBOOT_CONFIG ?= "sd"
UBOOT_CONFIG[sd] = "mx7dsabresd_config,sdcard"
UBOOT_CONFIG[mfgtool] = "mx7dsabresd_config"
```

## conf/machine/ring-redsky.conf
```bitbake
#@TYPE: Machine
#@NAME: Ring Solutions i.MX7D Platform
#@SOC: i.MX7D
#@DESCRIPTION: Machine configuration for Ring Solutions i.MX7D Platform
#@MAINTAIONER: Demetrius Pampouktsis <demetrius.pampouktsis@ring.com>

require conf/machine/include/imx-base.inc
require conf/machine/include/tune-cortexa7.inc
require conf/machine/include/redsky-base.inc

MACHINE_FEATURES += " wifi bluetooth ext4 alsa ppp wifi phone"

MACHINEOVERRIDES =. "mx7:mx7d:"

IMAGE_M4LOADER = "imx-m4-demos"
#IMAGE_M4 = ""
```
